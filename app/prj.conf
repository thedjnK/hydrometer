## CMakeLists.txt
```
# SPDX-License-Identifier: Apache-2.0

cmake_minimum_required(VERSION 3.20.0)

find_package(Zephyr REQUIRED HINTS $ENV{ZEPHYR_BASE})
project(hydrometer)

target_sources(app PRIVATE
               src/main.c
               src/filter.c
               src/bluetooth.c
               )
```

## Kconfig
```
# Copyright 2024 Jamie M.

menu "Application settings"

module = APPLICATION
module-str = application
source "subsys/logging/Kconfig.template.log_config"

config APP_READINGS
	int "Readings"
	range 1 8
	default 3
	help
	  Number of readings to average (1 being no averaging)

endmenu

source "Kconfig.zephyr"
```

## prj.conf
```kconfig
CONFIG_I2C=y
CONFIG_SENSOR=y
CONFIG_MPU6050_TRIGGER_NONE=y
CONFIG_MPU6050_ACCEL_FS=8
CONFIG_MPU6050_GYRO_FS=1000
CONFIG_CBPRINTF_FP_SUPPORT=y
CONFIG_LOG=y
CONFIG_FPU=y

CONFIG_MAIN_STACK_SIZE=3096
CONFIG_ISR_STACK_SIZE=1024
CONFIG_PRIVILEGED_STACK_SIZE=1024

CONFIG_BT=y
CONFIG_BT_PERIPHERAL=y
#CONFIG_BT_PHY_UPDATE=n
CONFIG_BT_L2CAP_TX_BUF_COUNT=5
CONFIG_BT_L2CAP_TX_MTU=255
CONFIG_BT_PERIPHERAL_PREF_LATENCY=6
CONFIG_BT_DEVICE_NAME="Zilla"
CONFIG_BT_DEVICE_APPEARANCE=1344
CONFIG_BT_CTLR_RX_BUFFERS=3
CONFIG_BT_CTLR_TX_PWR_PLUS_4=y
CONFIG_BT_CTLR_LE_ENC=n
CONFIG_BT_CTLR_MIN_USED_CHAN=n
CONFIG_BT_BUF_ACL_TX_SIZE=255
CONFIG_BT_BUF_ACL_RX_SIZE=255
CONFIG_BT_BUF_EVT_RX_SIZE=255
CONFIG_BT_BUF_EVT_DISCARDABLE_SIZE=255
CONFIG_BT_BUF_CMD_TX_SIZE=255
CONFIG_BT_CTLR_DATA_LENGTH_MAX=251
CONFIG_BT_PERIPHERAL_PREF_MIN_INT=12
CONFIG_BT_PERIPHERAL_PREF_MAX_INT=20
CONFIG_BT_PERIPHERAL_PREF_LATENCY=6
CONFIG_BT_PERIPHERAL_PREF_TIMEOUT=50
```

## src/main.c
```c
/*
 * Copyright (c) 2024 Jamie M.
 *
 * All right reserved. This code is not apache or FOSS/copyleft licensed.
 */

#include <zephyr/kernel.h>
#include <zephyr/device.h>
#include <zephyr/drivers/sensor.h>
#include <zephyr/logging/log.h>
#include "filter.h"
#include "bluetooth.h"

LOG_MODULE_REGISTER(app, CONFIG_APPLICATION_LOG_LEVEL);

static int sensor_reading(const struct device *dev, double *temperature, double *acceleration, double *gyroscope)
{
	struct sensor_value temperature_holding;
	struct sensor_value acceleration_holding[3];
	struct sensor_value gyroscope_holding[3];
	int rc;
	uint8_t i = 0;

	*temperature = 0.0f;

	while (i < 3) {
		acceleration[i] = 0.0f;
		gyroscope[i] = 0.0f;
		++i;
	}

	i = 0;

	while (i < CONFIG_APP_READINGS) {
		rc = sensor_sample_fetch(dev);

		if (rc) {
			LOG_ERR("Fetch readings failed: %d", rc);
			return rc;
		}

		if (i == 0) {
			rc = sensor_channel_get(dev, SENSOR_CHAN_DIE_TEMP, &temperature_holding);

			if (rc) {
				LOG_ERR("Get temperature reading failed: %d", rc);
				return rc;
			}

			*temperature += sensor_value_to_double(&temperature_holding);
		}

		rc = sensor_channel_get(dev, SENSOR_CHAN_ACCEL_XYZ, &acceleration_holding[3 * i]);

		if (rc) {
			LOG_ERR("Get acceleration reading failed: %d", rc);
			return rc;
		}

		rc = sensor_channel_get(dev, SENSOR_CHAN_GYRO_XYZ, &gyroscope_holding[3 * i]);

		if (rc) {
			LOG_ERR("Get gyroscope reading failed: %d", rc);
			return rc;
		}

		acceleration[0] += sensor_value_to_double(&acceleration_holding[0]);
		acceleration[1] += sensor_value_to_double(&acceleration_holding[1]);
		acceleration[2] += sensor_value_to_double(&acceleration_holding[2]);

		gyroscope[0] += sensor_value_to_double(&gyroscope_holding[0]);
		gyroscope[1] += sensor_value_to_double(&gyroscope_holding[1]);
		gyroscope[2] += sensor_value_to_double(&gyroscope_holding[2]);

		++i;
	}

#if CONFIG_APP_READINGS > 0
	i = 0;

	while (i < 3) {
		acceleration[i] /= CONFIG_APP_READINGS;
		gyroscope[i] /= CONFIG_APP_READINGS;

		++i;
	}
#endif

	return 0;
}

int main(void)
{
	const struct device *const mpu6500 = DEVICE_DT_GET_ONE(invensense_mpu6050);

	setup_bluetooth();

	if (!device_is_ready(mpu6500)) {
		LOG_ERR("Device init failed: %s", mpu6500->name);

		return 0;
	}

	while (1) {
		double temperature;
		double acceleration[3];
		double gyroscope[3];
		double roll;
		double pitch;
		int rc;

		rc = sensor_reading(mpu6500, &temperature, acceleration, gyroscope);

		if (rc != 0) {
			break;
		}

		calculate_angle(acceleration, gyroscope, true, &roll, &pitch);
		LOG_ERR("Got: %f, %f", roll, pitch);

//		k_sleep(K_SECONDS(1));
		k_sleep(K_MSEC(50));
	}

	return 0;
}
```

## src/bluetooth.c
```c
/*
 * Copyright (c) 2024 Jamie M.
 *
 * All right reserved. This code is not apache or FOSS/copyleft licensed.
 */

#include <zephyr/types.h>
#include <errno.h>
#include <zephyr/sys/byteorder.h>
#include <zephyr/kernel.h>
#include <zephyr/logging/log.h>
#include <zephyr/bluetooth/bluetooth.h>
#include <zephyr/bluetooth/conn.h>
#include <zephyr/bluetooth/uuid.h>
#include <zephyr/bluetooth/gatt.h>
//#include <zephyr/bluetooth/services/bas.h>
#include "bluetooth.h"

LOG_MODULE_DECLARE(app);

#define HYDROMETER_SVC_UUID BT_UUID_128_ENCODE(0x6565432a, 0xafc0, 0x4812, 0xbb2a, 0x22532a48b000)
#define CONTROL_CHAR_UUID BT_UUID_128_ENCODE(0x6565432a, 0xafc0, 0x4812, 0xbb2a, 0x22532a48b001)
#define TEMPERATURE_CHAR_UUID BT_UUID_128_ENCODE(0x6565432a, 0xafc0, 0x4812, 0xbb2a, 0x22532a48b002)
#define ROLL_CHAR_UUID BT_UUID_128_ENCODE(0x6565432a, 0xafc0, 0x4812, 0xbb2a, 0x22532a48b003)
#define PITCH_CHAR_UUID BT_UUID_128_ENCODE(0x6565432a, 0xafc0, 0x4812, 0xbb2a, 0x22532a48b004)

static const struct bt_uuid_128 hydrometer_svc_uuid = BT_UUID_INIT_128(HYDROMETER_SVC_UUID);
static const struct bt_uuid_128 hydrometer_control_char_uuid = BT_UUID_INIT_128(CONTROL_CHAR_UUID);
static const struct bt_uuid_128 temperature_reading_char_uuid = BT_UUID_INIT_128(TEMPERATURE_CHAR_UUID);
static const struct bt_uuid_128 roll_reading_char_uuid = BT_UUID_INIT_128(ROLL_CHAR_UUID);
static const struct bt_uuid_128 pitch_reading_char_uuid = BT_UUID_INIT_128(PITCH_CHAR_UUID);

static void bluetooth_advertise(void);

struct hydrometer_sensor_data {
	double temperature;
	double roll;
	double pitch;
};

static struct hydrometer_sensor_data sensor_data;

static void sensor_cccd_changed(const struct bt_gatt_attr *attr,
				 uint16_t value)
{
//	simulate_temp = value == BT_GATT_CCC_NOTIFY;
}

static ssize_t write_hyrdrometer_control(struct bt_conn *conn, const struct bt_gatt_attr *attr,
					 const void *buf, uint16_t len, uint16_t offset,
					 uint8_t flags)
{
	return 0;
}

static ssize_t read_sensor(struct bt_conn *conn, const struct bt_gatt_attr *attr, void *buf,
			   uint16_t len, uint16_t offset)
{
	const double *value = (const double *)attr->user_data;
	uint64_t send_value = sys_cpu_to_le64(*(uint64_t *)value);

	return bt_gatt_attr_read(conn, attr, buf, len, offset, &send_value, sizeof(send_value));
}

static void update_temperature(struct bt_conn *conn,
			       const struct bt_gatt_attr *chrc, int16_t value,
			       struct temperature_sensor *sensor)
{
#if 0
	/* Update temperature value */
	sensor->temp_value = value;

	/* Trigger notification if conditions are met */
	if (notify) {
		value = sys_cpu_to_le16(sensor->temp_value);

		bt_gatt_notify(conn, chrc, &value, sizeof(value));
	}
#endif
}

BT_GATT_SERVICE_DEFINE(hydrometer_svc,
	BT_GATT_PRIMARY_SERVICE(&hydrometer_svc_uuid),

	/* Control endpoint (clear settings/add calibration) */
	BT_GATT_CHARACTERISTIC(&hydrometer_control_char_uuid.uuid, BT_GATT_CHRC_WRITE,
			       BT_GATT_PERM_WRITE, NULL, write_hyrdrometer_control, NULL),

	/* Temperature reading */
	BT_GATT_CHARACTERISTIC(&temperature_reading_char_uuid.uuid,
			       (BT_GATT_CHRC_READ | BT_GATT_CHRC_NOTIFY), BT_GATT_PERM_READ,
			       read_sensor, NULL, &sensor_data.temperature),
	BT_GATT_CCC(sensor_cccd_changed, (BT_GATT_PERM_READ | BT_GATT_PERM_WRITE)),

	/* Roll reading */
	BT_GATT_CHARACTERISTIC(&roll_reading_char_uuid.uuid,
			       (BT_GATT_CHRC_READ | BT_GATT_CHRC_NOTIFY), BT_GATT_PERM_READ,
			       read_sensor, NULL, &sensor_data.roll),
	BT_GATT_CCC(sensor_cccd_changed, (BT_GATT_PERM_READ | BT_GATT_PERM_WRITE)),

	/* Pitch reading */
	BT_GATT_CHARACTERISTIC(&pitch_reading_char_uuid.uuid,
			       (BT_GATT_CHRC_READ | BT_GATT_CHRC_NOTIFY), BT_GATT_PERM_READ,
			       read_sensor, NULL, &sensor_data.pitch),
	BT_GATT_CCC(sensor_cccd_changed, (BT_GATT_PERM_READ | BT_GATT_PERM_WRITE)),

);

static const struct bt_data ad[] = {
	BT_DATA_BYTES(BT_DATA_FLAGS, (BT_LE_AD_GENERAL | BT_LE_AD_NO_BREDR)),
	BT_DATA_BYTES(BT_DATA_GAP_APPEARANCE, 0x00, 0x03),
	BT_DATA_BYTES(BT_DATA_UUID128_ALL, HYDROMETER_SVC_UUID),
};

static void bluetooth_connected(struct bt_conn *conn, uint8_t err)
{
	if (err) {
		LOG_INF("Connection failed: %d", err);
		bluetooth_advertise();
	} else {
		LOG_INF("Connected");
	}
}

static void bluetooth_disconnected(struct bt_conn *conn, uint8_t reason)
{
	printk("Disconnected: %d", reason);
	bluetooth_advertise();
}

BT_CONN_CB_DEFINE(conn_callbacks) = {
	.connected = bluetooth_connected,
	.disconnected = bluetooth_disconnected,
};

static void bluetooth_advertise(void)
{
	int rc;

	rc = bt_le_adv_start(BT_LE_ADV_CONN_NAME, ad, ARRAY_SIZE(ad), NULL, 0);

	if (rc) {
		LOG_ERR("Advertising failed to start: %d", rc);
		return;
	}

	LOG_INF("Advertising started");
}

#if 0
static void bas_notify(void)
{
	uint8_t battery_level = bt_bas_get_battery_level();

	battery_level--;

	if (!battery_level) {
		battery_level = 100U;
	}

	bt_bas_set_battery_level(battery_level);
}
#endif

int setup_bluetooth(void)
{
	int rc;

	rc = bt_enable(NULL);

	if (rc) {
		LOG_ERR("Bluetooth init failed: %d", rc);
		return rc;
	}

	bluetooth_advertise();

sensor_data.temperature = 123.456;
sensor_data.roll = 0.1;
sensor_data.pitch = 5.5;

	return 0;
}
```

## src/bluetooth.h
```c
/*
 * Copyright (c) 2024 Jamie M.
 *
 * All right reserved. This code is not apache or FOSS/copyleft licensed.
 */

#include <zephyr/types.h>

int setup_bluetooth(void);
```

## src/filter.c
```c
/*
 * Copyright (c) 2022 Carbon Aeronautics.
 *
 * Adapted from https://github.com/CarbonAeronautics/Part-XV-1DKalmanFilter/blob/main/ArduinoCode
 *
 * All right reserved.
 */

/* TODO: replace with sensorfusion */
#include <math.h>
#include <stdbool.h>
#include "filter.h"

static double kalman_angle_roll = 0;
static double kalman_uncertainty_angle_roll = 2 * 2;
static double kalman_angle_pitch = 0;
static double kalman_uncertainty_angle_pitch = 2 * 2;

static void kalman_1d(double *kalman_state, double *kalman_uncertainty, double kalman_input, double kalman_measurement) {
	*kalman_state = *kalman_state + 0.2 * kalman_input;
	*kalman_uncertainty = *kalman_uncertainty + 0.2 * 0.2 * 4 * 4;
	double kalman_gain = *kalman_uncertainty * 1 / (1 * *kalman_uncertainty + 3 * 3);
	*kalman_state = *kalman_state + kalman_gain * (kalman_measurement - *kalman_state);
	*kalman_uncertainty = (1 - kalman_gain) * *kalman_uncertainty;
}

void calculate_angle(const double *acceleration, const double *gyroscope, bool filter, double *roll, double *pitch)
{
	double angle_roll = atan(acceleration[1] / sqrt(pow(acceleration[0], 2) + pow(acceleration[2], 2))) * 180.0 / 3.141592653827;
	double angle_pitch = -atan(acceleration[0] / sqrt(pow(acceleration[1], 2) + pow(acceleration[2], 2))) * 180.0 / 3.141592653827;

	kalman_1d(&kalman_angle_roll, &kalman_uncertainty_angle_roll, gyroscope[0], angle_roll);
	kalman_1d(&kalman_angle_pitch, &kalman_uncertainty_angle_pitch, gyroscope[1], angle_pitch);

	*roll = kalman_angle_roll;
	*pitch = kalman_angle_pitch;

//      LOG_ERR("Got: %f, %f : %f, %f", angle_roll, angle_pitch, kalman_angle_roll, kalman_angle_pitch);
}
```

## src/filter.h
```c
/*
 * Copyright (c) 2022 Carbon Aeronautics.
 *
 * Adapted from https://github.com/CarbonAeronautics/Part-XV-1DKalmanFilter/blob/main/ArduinoCode
 *
 * All right reserved.
 */

/* TODO: replace with sensorfusion */
#include <stdint.h>

void calculate_angle(const double *acceleration, const double *gyroscope, bool filter, double *roll, double *pitch);
```
