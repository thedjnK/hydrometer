## west.yml
```yaml
manifest:
  remotes:
    - name: zephyr
      url-base: https://github.com/zephyrproject-rtos

  projects:
    - name: zephyr
      remote: zephyr
      revision: pull/70130/head
      import:
        name-allowlist:
          - cmsis
          - hal_nordic
          - mcuboot
          - picolibc
          - tinycrypt
          - zcbor

  self:
    path: hydrometer
```
